## ble_midi/Kconfig
```kconfig
config BLE_MIDI
	bool "Enable BLE MIDI"
	depends on BT
  depends on BT_PERIPHERAL

if BLE_MIDI

config BLE_MIDI_SEND_RUNNING_STATUS
  bool "Enable running status for transmitted MIDI messages"
	default n

config BLE_MIDI_SEND_NOTE_OFF_AS_NOTE_ON
  bool "Represent note off messages as note on with zero velocity. Increases running status efficiency."
  default n

config BLE_MIDI_TX_PACKET_MAX_SIZE
  int ""
  default 244

config BLE_MIDI_CONN_EVENT_NOTIFICATION_DISTANCE_US
  int "Prepare and submit BLE packets for transmission this many μs before each connection event. Used when BLE_MIDI_TX_MODE_CONN_EVENT is enabled."
  default 1200

config BLE_MIDI_TX_QUEUE_PACKET_COUNT
  int ""
  default 1

config BLE_MIDI_TX_FIFO_SIZE
  int ""
  default 256

choice BLE_MIDI_TX_MODE
    bool "Determines how transmission of BLE packets is triggered"
    default BLE_MIDI_TX_MODE_SINGLE_MSG

config BLE_MIDI_TX_MODE_SINGLE_MSG
    bool "Outgoing MIDI messages are sent immediately in separate BLE packets."

config BLE_MIDI_TX_MODE_MANUAL
    bool "Outgoing MIDI messages are buffered but not sent until the caller decides to do so."
    select RING_BUFFER

config BLE_MIDI_TX_MODE_CONN_EVENT
    bool "Outgoing MIDI messages are buffered and sent just before the next connection event. Uses the Event Trigger API added in nRF Connect SDK v2.6.0."
    select RING_BUFFER
    select BT_CTLR_SDC_EVENT_TRIGGER
    # SoftDevice seems to use TIMER0, so don't use that.
    # see https://devzone.nordicsemi.com/f/nordic-q-a/38502/nrfx-timer-issue
    select NRFX_TIMER3
    # CONFIG_BT_LL_SOFTDEVICE_MULTIROLE is needed for CONFIG_BT_CTLR_SDC_EVENT_TRIGGER to work.
    # Unfortunately, it also adds 60kbytes to the image size in an optimized build.
    # See https://devzone.nordicsemi.com/f/nordic-q-a/112166/does-the-event-trigger-api-always-require-config_bt_central-significantly-increases-peripheral-image-size
    select CONFIG_BT_LL_SOFTDEVICE_MULTIROLE
    # select CONFIG_BT_CENTRAL

config BLE_MIDI_TX_MODE_CONN_EVENT_LEGACY
    bool "Outgoing MIDI messages are buffered and sent just before the next connection event. Relies on the MPSL radio notifications API that was removed in nRF Connect SDK v2.6.0 or newer."
    select RING_BUFFER
    select MPSL

endchoice

module = BLE_MIDI
module-str = BLE MIDI
source "subsys/logging/Kconfig.template.log_config"

endif # BLE_MIDI
```

## build_nrf52/Kconfig/Kconfig.modules
```kconfig
menu "nrf (/opt/nordic/ncs/v2.1.2/nrf)"
osource "/opt/nordic/ncs/v2.1.2/nrf/Kconfig.nrf"
config ZEPHYR_NRF_MODULE
	bool
	default y
endmenu
menu "hostap (/opt/nordic/ncs/v2.1.2/modules/lib/hostap)"
osource "/opt/nordic/ncs/v2.1.2/modules/lib/hostap/zephyr/Kconfig"
config ZEPHYR_HOSTAP_MODULE
	bool
	default y
endmenu
menu "mcuboot (/opt/nordic/ncs/v2.1.2/bootloader/mcuboot)"
osource "$(ZEPHYR_MCUBOOT_KCONFIG)"
config ZEPHYR_MCUBOOT_MODULE
	bool
	default y
endmenu
menu "mbedtls (/opt/nordic/ncs/v2.1.2/modules/crypto/mbedtls)"
osource "$(ZEPHYR_MBEDTLS_KCONFIG)"
config ZEPHYR_MBEDTLS_MODULE
	bool
	default y
endmenu
menu "trusted-firmware-m (/opt/nordic/ncs/v2.1.2/modules/tee/tf-m/trusted-firmware-m)"
osource "$(ZEPHYR_TRUSTED_FIRMWARE_M_KCONFIG)"
config ZEPHYR_TRUSTED_FIRMWARE_M_MODULE
	bool
	default y
endmenu
menu "cjson (/opt/nordic/ncs/v2.1.2/modules/lib/cjson)"
osource "$(ZEPHYR_CJSON_KCONFIG)"
config ZEPHYR_CJSON_MODULE
	bool
	default y
endmenu
menu "azure-sdk-for-c (/opt/nordic/ncs/v2.1.2/modules/lib/azure-sdk-for-c)"
osource "$(ZEPHYR_AZURE_SDK_FOR_C_KCONFIG)"
config ZEPHYR_AZURE_SDK_FOR_C_MODULE
	bool
	default y
endmenu
menu "memfault-firmware-sdk (/opt/nordic/ncs/v2.1.2/modules/lib/memfault-firmware-sdk)"
osource "/opt/nordic/ncs/v2.1.2/modules/lib/memfault-firmware-sdk/ports/zephyr/Kconfig"
config ZEPHYR_MEMFAULT_FIRMWARE_SDK_MODULE
	bool
	default y
endmenu
menu "cirrus-logic (/opt/nordic/ncs/v2.1.2/modules/hal/cirrus-logic)"
osource "/opt/nordic/ncs/v2.1.2/modules/hal/cirrus-logic/Kconfig"
config ZEPHYR_CIRRUS_LOGIC_MODULE
	bool
	default y
endmenu
menu "openthread (/opt/nordic/ncs/v2.1.2/modules/lib/openthread)"
osource "$(ZEPHYR_OPENTHREAD_KCONFIG)"
config ZEPHYR_OPENTHREAD_MODULE
	bool
	default y
endmenu
menu "canopennode (/opt/nordic/ncs/v2.1.2/modules/lib/canopennode)"
osource "$(ZEPHYR_CANOPENNODE_KCONFIG)"
config ZEPHYR_CANOPENNODE_MODULE
	bool
	default y
endmenu
menu "chre (/opt/nordic/ncs/v2.1.2/modules/lib/chre)"
osource "/opt/nordic/ncs/v2.1.2/modules/lib/chre/platform/zephyr/Kconfig"
config ZEPHYR_CHRE_MODULE
	bool
	default y
endmenu
menu "hal_nordic (/opt/nordic/ncs/v2.1.2/modules/hal/nordic)"
osource "$(ZEPHYR_HAL_NORDIC_KCONFIG)"
config ZEPHYR_HAL_NORDIC_MODULE
	bool
	default y
endmenu
menu "liblc3codec (/opt/nordic/ncs/v2.1.2/modules/lib/liblc3codec)"
osource "$(ZEPHYR_LIBLC3CODEC_KCONFIG)"
config ZEPHYR_LIBLC3CODEC_MODULE
	bool
	default y
endmenu
menu "littlefs (/opt/nordic/ncs/v2.1.2/modules/fs/littlefs)"
osource "$(ZEPHYR_LITTLEFS_KCONFIG)"
config ZEPHYR_LITTLEFS_MODULE
	bool
	default y
endmenu
menu "loramac-node (/opt/nordic/ncs/v2.1.2/modules/lib/loramac-node)"
osource "$(ZEPHYR_LORAMAC_NODE_KCONFIG)"
config ZEPHYR_LORAMAC_NODE_MODULE
	bool
	default y
endmenu
menu "lvgl (/opt/nordic/ncs/v2.1.2/modules/lib/gui/lvgl)"
osource "/opt/nordic/ncs/v2.1.2/modules/lib/gui/lvgl/zephyr/Kconfig"
config ZEPHYR_LVGL_MODULE
	bool
	default y
endmenu
menu "lz4 (/opt/nordic/ncs/v2.1.2/modules/lib/lz4)"
osource "$(ZEPHYR_LZ4_KCONFIG)"
config ZEPHYR_LZ4_MODULE
	bool
	default y
endmenu
menu "nanopb (/opt/nordic/ncs/v2.1.2/modules/lib/nanopb)"
osource "$(ZEPHYR_NANOPB_KCONFIG)"
config ZEPHYR_NANOPB_MODULE
	bool
	default y
endmenu
menu "picolibc (/opt/nordic/ncs/v2.1.2/modules/lib/picolibc)"
osource "/opt/nordic/ncs/v2.1.2/modules/lib/picolibc/zephyr/Kconfig"
config ZEPHYR_PICOLIBC_MODULE
	bool
	default y
endmenu
menu "TraceRecorder (/opt/nordic/ncs/v2.1.2/modules/debug/TraceRecorder)"
osource "/opt/nordic/ncs/v2.1.2/modules/debug/TraceRecorder/kernelports/Zephyr/Kconfig"
config ZEPHYR_TRACERECORDER_MODULE
	bool
	default y
endmenu
menu "zcbor (/opt/nordic/ncs/v2.1.2/modules/lib/zcbor)"
osource "$(ZEPHYR_ZCBOR_KCONFIG)"
config ZEPHYR_ZCBOR_MODULE
	bool
	default y
endmenu
menu "zscilib (/opt/nordic/ncs/v2.1.2/modules/lib/zscilib)"
osource "/opt/nordic/ncs/v2.1.2/modules/lib/zscilib/Kconfig.zscilib"
config ZEPHYR_ZSCILIB_MODULE
	bool
	default y
endmenu
menu "nrfxlib (/opt/nordic/ncs/v2.1.2/nrfxlib)"
osource "/opt/nordic/ncs/v2.1.2/nrfxlib/Kconfig.nrfxlib"
config ZEPHYR_NRFXLIB_MODULE
	bool
	default y
endmenu
menu "connectedhomeip (/opt/nordic/ncs/v2.1.2/modules/lib/matter)"
osource "/opt/nordic/ncs/v2.1.2/modules/lib/matter/config/nrfconnect/chip-module/Kconfig"
config ZEPHYR_CONNECTEDHOMEIP_MODULE
	bool
	default y
endmenu
```
