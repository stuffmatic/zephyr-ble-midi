## CMakeLists.txt
```
# Add the BLE MIDI service module. CMAKE_CURRENT_SOURCE_DIR is 
# the dir containing the sample app's CMakeLists.txt, i.e the 
# repository root dir, which is also the root dir of the
# driver module.
list(APPEND ZEPHYR_EXTRA_MODULES
  ${CMAKE_CURRENT_SOURCE_DIR}
  )

cmake_minimum_required(VERSION 3.20.0)
find_package(Zephyr REQUIRED HINTS $ENV{ZEPHYR_BASE})
project(ble_midi_sample)

target_sources(app PRIVATE src/main.c)
target_sources_ifdef(CONFIG_BT_SMP app PRIVATE src/ble_pairing.c)
```

## Kconfig
```
source "Kconfig.zephyr"

config BLE_MIDI_SEND_RUNNING_STATUS
  bool ""
	default y

config BLE_MIDI_SEND_NOTE_OFF_AS_NOTE_ON
  bool ""
  default y

config BLE_MIDI_NRF_BATCH_TX
  bool ""
  default n
```

## prj.conf
```kconfig
CONFIG_BT=y
CONFIG_BT_PERIPHERAL=y

CONFIG_BT_DEVICE_NAME="zephyr-ble-midi"

CONFIG_BLE_MIDI=y
CONFIG_BLE_MIDI_TX_FIFO_SIZE=1024

# Request a large MTU to better handle
# lots of MIDI messages being sent at once.
# Also increases streaming sysex throughput.
# https://docs.zephyrproject.org/latest/samples/bluetooth/mtu_update/README.html
CONFIG_BT_L2CAP_TX_MTU=247
CONFIG_BT_BUF_ACL_TX_SIZE=251
CONFIG_BT_BUF_ACL_RX_SIZE=251
CONFIG_BLE_MIDI_TX_PACKET_MAX_SIZE=244

CONFIG_RING_BUFFER=y

# CONFIG_HEAP_MEM_POOL_SIZE=2048
# CONFIG_HEAP_MEM_POOL_SIZE=2048
# CONFIG_BT_GAP_AUTO_UPDATE_CONN_PARAMS=n

# CONFIG_BLE_MIDI_TX_MODE_SINGLE_MSG=y
# CONFIG_BLE_MIDI_TX_MODE_MANUAL=y
# CONFIG_BLE_MIDI_TX_MODE_CONN_EVENT_LEGACY=y
CONFIG_BLE_MIDI_TX_MODE_CONN_EVENT=y
# CONFIG_BT_LL_SOFTDEVICE_MULTIROLE=y

CONFIG_BT_PERIPHERAL_PREF_MIN_INT=6
CONFIG_BT_PERIPHERAL_PREF_MAX_INT=6
```

## debug.conf
```kconfig
# CONFIG_BT_DEBUG_LOG=y
CONFIG_ASSERT=y
CONFIG_DEBUG_OPTIMIZATIONS=y
CONFIG_DEBUG_THREAD_INFO=y
CONFIG_LOG=y
CONFIG_BLE_MIDI_LOG_LEVEL_DBG=y
# CONFIG_BLE_MIDI_LOG_LEVEL_INF=y

# CONFIG_LOG_BUFFER_SIZE=65536
# CONFIG_BT_HCI_CORE_LOG_LEVEL_DBG=y 
# CONFIG_BT_HCI_DRIVER_LOG_LEVEL_DBG=y 
```

## pairing.conf
```kconfig
CONFIG_BT_SMP=y
CONFIG_BT_PRIVACY=y
CONFIG_SETTINGS=y
CONFIG_NVS=y
CONFIG_FLASH=y
CONFIG_FLASH_PAGE_LAYOUT=y
CONFIG_FLASH_MAP=y
CONFIG_BT_SETTINGS=y
CONFIG_BT_ID_MAX=2
```

## proj.conf
```kconfig
CONFIG_BT=y
CONFIG_BT_DEBUG_LOG=y
CONFIG_BT_MAX_CONN=1
CONFIG_BT_L2CAP_TX_BUF_COUNT=5
CONFIG_BT_PERIPHERAL=y
CONFIG_BT_DEVICE_NAME="My_Device"
CONFIG_BT_DEVICE_APPEARANCE=962

CONFIG_HEAP_MEM_POOL_SIZE=2048

# This example requires more workqueue stack
CONFIG_SYSTEM_WORKQUEUE_STACK_SIZE=2048
```

## src/main.c
```c
#include <zephyr/kernel.h>
#include <zephyr/drivers/gpio.h>
#include <zephyr/bluetooth/uuid.h>
#include <zephyr/bluetooth/gatt.h>
#include <zephyr/bluetooth/bluetooth.h>
#include <zephyr/sys/ring_buffer.h>
#include <ble_midi/ble_midi.h>

#ifdef CONFIG_BT_SMP
#include "ble_pairing.h"
#endif

#include <zephyr/logging/log.h>
LOG_MODULE_REGISTER(ble_midi_sample);

static void log_sysex_transfer_time(int is_tx, int num_bytes, int time_ms) {
	float bytes_per_s = time_ms == 0 ? 0 : (float)num_bytes / (0.001f * time_ms);
	LOG_INF("sysex %s done | %d bytes in %d ms | %d bytes/s", is_tx ? "tx" : "rx",
		num_bytes, (int)time_ms, (int)bytes_per_s);
}

/************************ App state ************************/
K_MSGQ_DEFINE(button_event_q, sizeof(uint8_t), 128, 4);

#define SYSEX_TX_MESSAGE_SIZE	20000
#define SYSEX_TX_MAX_CHUNK_SIZE 130
static uint8_t sysex_tx_chunk[SYSEX_TX_MAX_CHUNK_SIZE];

struct sample_app_state_t {
	int is_connected;
	int ble_midi_is_ready;
	int sysex_rx_data_byte_count;
	int sysex_tx_data_byte_count;
	int64_t sysex_tx_start_time_ms;
	int sysex_tx_in_progress;
	int64_t sysex_rx_start_time_ms;
	int sysex_rx_in_progress;
	int button_states[4];
};

static struct sample_app_state_t sample_app_state = {
							 .is_connected = 0,
							 .ble_midi_is_ready = 0,
						     .sysex_tx_data_byte_count = 0,
						     .sysex_tx_in_progress = 0,
							 .sysex_rx_in_progress = 0,
							 .sysex_tx_start_time_ms = 0,
							 .sysex_tx_start_time_ms = 0,
						     .sysex_rx_data_byte_count = 0,
						     .button_states = {0, 0, 0, 0}};

/************************ LEDs ************************/

#define LED_COUNT	     4
/* Turn on this LED when the BLE MIDI is perihperal is connected */
#define LED_CONNECTED	 0
/* Turn on this LED when the BLE MIDI service is ready. */
#define LED_READY	     1
/* Toggle this LED when receiving sysex messages */
#define LED_RX_SYSEX	 2
/* Toggle this LED when receiving non-sysex messages */
#define LED_RX_NON_SYSEX 3

static const struct gpio_dt_spec leds[LED_COUNT] = {GPIO_DT_SPEC_GET(DT_ALIAS(led0), gpios),
						    GPIO_DT_SPEC_GET(DT_ALIAS(led1), gpios),
						    GPIO_DT_SPEC_GET(DT_ALIAS(led2), gpios),
							GPIO_DT_SPEC_GET(DT_ALIAS(led3), gpios)};

static void init_leds()
{
	for (int i = 0; i < LED_COUNT; i++) {
		gpio_pin_configure_dt(&leds[i], GPIO_OUTPUT_ACTIVE);
		gpio_pin_set_dt(&leds[i], 0);
	}
}

/* Ringbuf/work queue */
RING_BUF_DECLARE(midi_msg_ringbuf, 128);
static void midi_msg_work_cb(struct k_work *w)
{
	uint8_t data[4] = {0, 0, 0, 0};
	while (ring_buf_get(&midi_msg_ringbuf, &data[0], 4) == 4) {
		uint8_t msg_byte_count = data[0];
		uint8_t *msg_bytes = &data[1];
		LOG_INF("MIDI rx | %02x %02x %02x | %d bytes", msg_bytes[0], msg_bytes[1], msg_bytes[2], msg_byte_count);
		gpio_pin_toggle_dt(&leds[LED_RX_NON_SYSEX]);
	};
}
static K_WORK_DEFINE(midi_msg_work, midi_msg_work_cb);

/************************ Buttons ************************/

#define BUTTON_COUNT	      4
#define BUTTON_TX_NON_SYSEX   0
#define BUTTON_TX_SYSEX_SHORT 1
#define BUTTON_TX_SYSEX_LONG  2
#define BUTTON_MANUAL_TX_FLUSH 3
static const struct gpio_dt_spec buttons[BUTTON_COUNT] = {
	GPIO_DT_SPEC_GET_OR(DT_ALIAS(sw0), gpios, {0}),
	GPIO_DT_SPEC_GET_OR(DT_ALIAS(sw1), gpios, {0}),
	GPIO_DT_SPEC_GET_OR(DT_ALIAS(sw2), gpios, {0}),
	GPIO_DT_SPEC_GET_OR(DT_ALIAS(sw3), gpios, {0})};
static struct gpio_callback button_cb_data;

static void button_pressed(const struct device *dev, struct gpio_callback *cb, uint32_t pins)
{
	for (int i = 0; i < BUTTON_COUNT; i++) {
		if ((pins & BIT(buttons[i].pin)) != 0) {
			sample_app_state.button_states[i] = !sample_app_state.button_states[i];
			int button_down = sample_app_state.button_states[i];
			int button_event_code = i | (button_down << 2);
			k_msgq_put(&button_event_q, &button_event_code, K_NO_WAIT);
		}
	}
}

static void init_buttons()
{
	for (int i = 0; i < BUTTON_COUNT; i++) {
		__ASSERT_NO_MSG(device_is_ready(buttons[i].port));
		int ret = gpio_pin_configure_dt(&buttons[i], GPIO_INPUT);
		__ASSERT_NO_MSG(ret == 0);
		ret = gpio_pin_interrupt_configure_dt(&buttons[i], GPIO_INT_EDGE_BOTH);
		__ASSERT_NO_MSG(ret == 0);
	}

	gpio_init_callback(&button_cb_data, button_pressed,
			   BIT(buttons[0].pin) | BIT(buttons[1].pin) | BIT(buttons[2].pin) | BIT(buttons[3].pin));
	int ret = gpio_add_callback(buttons[0].port, &button_cb_data);
	__ASSERT_NO_MSG(ret == 0);
}

/****************** BLE MIDI callbacks ******************/
static void ble_midi_ready_cb(ble_midi_ready_state_t state)
{
	int is_connected = state != BLE_MIDI_STATE_NOT_CONNECTED;
	int is_ready = state == BLE_MIDI_STATE_READY;
	
	gpio_pin_set_dt(&leds[LED_CONNECTED], is_connected);
	gpio_pin_set_dt(&leds[LED_READY], is_ready);

	if (!is_ready) {
		gpio_pin_set_dt(&leds[LED_RX_NON_SYSEX], 0);
		gpio_pin_set_dt(&leds[LED_RX_SYSEX], 0);
	}

	sample_app_state.is_connected = is_connected;
	sample_app_state.ble_midi_is_ready = is_ready;
}

static void tx_done_cb()
{
	if (sample_app_state.sysex_tx_in_progress) {
		if (sample_app_state.sysex_tx_data_byte_count == SYSEX_TX_MESSAGE_SIZE) {
			u_int64_t dt_ms = k_uptime_get() - sample_app_state.sysex_tx_start_time_ms;
			log_sysex_transfer_time(1, SYSEX_TX_MESSAGE_SIZE + 2, dt_ms);
			ble_midi_tx_sysex_end();
			sample_app_state.sysex_tx_in_progress = 0;
		} else {
#ifndef CONFIG_BLE_MIDI_TX_MODE_SINGLE_MSG
			// Fill tx fifo. TODO: fix contents
			while (true) {
				int num_bytes_left_to_send = SYSEX_TX_MESSAGE_SIZE - sample_app_state.sysex_tx_data_byte_count;
				int num_bytes_to_send = num_bytes_left_to_send > SYSEX_TX_MAX_CHUNK_SIZE ? SYSEX_TX_MAX_CHUNK_SIZE : num_bytes_left_to_send;
				if (num_bytes_to_send > 0) {
					int result = ble_midi_tx_sysex_data(sysex_tx_chunk, num_bytes_to_send);
					if (result == BLE_MIDI_TX_FIFO_FULL) {
						break;
					}
					sample_app_state.sysex_tx_data_byte_count += result;
				} else {
					break;
				}
			}
#else
			for (int i = 0; i < SYSEX_TX_MAX_CHUNK_SIZE; i++) {
				sysex_tx_chunk[i] = (sample_app_state.sysex_tx_data_byte_count + i) % 128;
			}
			int num_bytes_left =
				SYSEX_TX_MESSAGE_SIZE - sample_app_state.sysex_tx_data_byte_count;
			int num_bytes_to_send = num_bytes_left < SYSEX_TX_MAX_CHUNK_SIZE
							? num_bytes_left
							: SYSEX_TX_MAX_CHUNK_SIZE;
			int num_bytes_sent = ble_midi_tx_sysex_data(sysex_tx_chunk, num_bytes_to_send);
			sample_app_state.sysex_tx_data_byte_count += num_bytes_sent;
#endif
		}
	}	
}

/** Called when a non-sysex message has been parsed */
static void ble_midi_message_cb(uint8_t *bytes, uint8_t num_bytes, uint16_t timestamp)
{
	uint8_t data[4] = {num_bytes, 0, 0, 0};
	for (int i = 0; i < num_bytes; i++) {
		data[i + 1] = bytes[i];
	}
	uint32_t num_bytes_written = ring_buf_put(&midi_msg_ringbuf, &data[0], 4);
	__ASSERT(num_bytes_written == 4, "Failed to write to MIDI msg ringbuf");
	k_work_submit(&midi_msg_work);
}

/** Called when a sysex message starts */
static void ble_midi_sysex_start_cb(uint16_t timestamp)
{
	sample_app_state.sysex_rx_start_time_ms = k_uptime_get();
	// printk("rx sysex start, t %d\n", timestamp);
}
/** Called when a sysex data byte has been received */
static void ble_midi_sysex_data_cb(uint8_t data_byte)
{
	sample_app_state.sysex_rx_data_byte_count += 1;
}
/** Called when a sysex message ends */
static void ble_midi_sysex_end_cb(uint16_t timestamp)
{
	u_int64_t dt_ms = k_uptime_get() - sample_app_state.sysex_rx_start_time_ms;
	log_sysex_transfer_time(0, sample_app_state.sysex_rx_data_byte_count + 2, dt_ms);
	gpio_pin_toggle_dt(&leds[LED_RX_SYSEX]);
}

#define DEVICE_NAME	CONFIG_BT_DEVICE_NAME
#define DEVICE_NAME_LEN (sizeof(DEVICE_NAME) - 1)

static const struct bt_data ad[] = {
	BT_DATA_BYTES(BT_DATA_FLAGS, (BT_LE_AD_GENERAL | BT_LE_AD_NO_BREDR)),
	BT_DATA(BT_DATA_NAME_COMPLETE, DEVICE_NAME, DEVICE_NAME_LEN)};

static const struct bt_data sd[] = {
	BT_DATA_BYTES(BT_DATA_UUID128_ALL, BLE_MIDI_SERVICE_UUID),
};

int main(void)
{
	init_leds();
	init_buttons();

	for (int i = 0; i < SYSEX_TX_MAX_CHUNK_SIZE; i++) {
		sysex_tx_chunk[i] = i % 128;
	}

	uint32_t err = bt_enable(NULL);
	#ifdef CONFIG_BT_SMP
	ble_pairing_load();
	#endif
	__ASSERT(err == 0, "bt_enable failed");

	/* Must be called after bt_enable */
	struct ble_midi_callbacks midi_callbacks = {.ready_cb = ble_midi_ready_cb,
						    .tx_done_cb = tx_done_cb,
						    .midi_message_cb = ble_midi_message_cb,
						    .sysex_start_cb = ble_midi_sysex_start_cb,
						    .sysex_data_cb = ble_midi_sysex_data_cb,
						    .sysex_end_cb = ble_midi_sysex_end_cb};
	ble_midi_init(&midi_callbacks);

	int ad_err = bt_le_adv_start(BT_LE_ADV_CONN, ad, ARRAY_SIZE(ad), sd, ARRAY_SIZE(sd));
	__ASSERT_NO_MSG(ad_err == 0);

	while (1) {
		/* Poll button events */
		int button_event_code = 0;
		k_msgq_get(&button_event_q, &button_event_code, K_FOREVER);

		int button_idx = button_event_code & 0x3;
		int button_down = button_event_code >> 2;
		if (!sample_app_state.sysex_tx_in_progress) {
			if (button_idx == BUTTON_TX_NON_SYSEX) {
				uint8_t status_byte =
					button_down ? 0x90 : 0x80; // Note on or note off?
				uint8_t chord_msgs[][3] = {
					{status_byte, 0x48, 0x7f},
					{status_byte, 0x4c, 0x7f},
					{status_byte, 0x4f, 0x7f},
				};
				ble_midi_tx_msg(&(chord_msgs[0][0]));
				ble_midi_tx_msg(&(chord_msgs[1][0]));
				ble_midi_tx_msg(&(chord_msgs[2][0]));
			} else if (button_idx == BUTTON_TX_SYSEX_SHORT && button_down) {
				uint8_t data_bytes[10] = {
					0x10, 0x11, 0x12, 0x13, 0x14, 0x15, 0x16, 0x17, 0x18, 0x19,
				};
				ble_midi_tx_sysex_start();
				ble_midi_tx_sysex_data(data_bytes, 10);
				ble_midi_tx_sysex_end();
			} else if (button_idx == BUTTON_TX_SYSEX_LONG && button_down) {
				/* Send the first byte of a sysex message that is too large
					to be sent at once. Use the tx done callback to send the
					next chunk repeatedly until done. */
				sample_app_state.sysex_tx_in_progress = 1;
				sample_app_state.sysex_tx_data_byte_count = 0;
				sample_app_state.sysex_tx_start_time_ms = k_uptime_get();
				ble_midi_tx_sysex_start();
			} else if (button_idx == BUTTON_MANUAL_TX_FLUSH) {
				#ifdef CONFIG_BLE_MIDI_TX_MODE_MANUAL
				ble_midi_tx_flush();
				#endif
			}
		}
	}
}
```

## src/ble_midi.c
```c
#include <zephyr/zephyr.h>
#include <logging/log.h>

#include <zephyr/bluetooth/bluetooth.h>
#include <zephyr/bluetooth/conn.h>
#include <zephyr/bluetooth/gatt.h>
#include <zephyr/bluetooth/uuid.h>

#include "ble_midi.h"
#include "ble_midi_packet.h"

LOG_MODULE_REGISTER(ble_midi);

#ifdef CONFIG_BLE_MIDI_NRF_BATCH_TX
#include <zephyr/init.h>
#include <zephyr/kernel.h>
#include <sys/ring_buffer.h>
#include <mpsl_radio_notification.h>
atomic_t has_tx_data = ATOMIC_INIT(0x00);
struct k_work_q work_q;
RING_BUF_DECLARE(msg_ringbuf, 128);
RING_BUF_DECLARE(sysex_ringbuf, 128);

#endif

static struct ble_midi_writer_t tx_writer;
static struct ble_midi_writer_t sysex_tx_writer;

static struct ble_midi_callbacks user_callbacks = {
    .available_cb = NULL,
		.tx_available_cb = NULL,
    .midi_message_cb = NULL,
		.sysex_start_cb = NULL,
		.sysex_data_cb = NULL,
		.sysex_end_cb = NULL,
};

static ssize_t midi_read_cb(struct bt_conn *conn,
			    const struct bt_gatt_attr *attr,
			    void *buf, uint16_t len,
			    uint16_t offset)
{
	/* Respond with empty payload as per section 3 of the spec. */
	return 0;
}

static void log_buffer(const char* tag, uint8_t* bytes, uint32_t num_bytes)
{
    printk("%s ", tag);
    for (int i = 0; i < num_bytes; i++)
	{
		printk("%02x ", ((uint8_t *)bytes)[i]);
	}
	printk("\n");
}

static ssize_t midi_write_cb(struct bt_conn *conn,
			     const struct bt_gatt_attr *attr,
			     const void *buf, uint16_t len,
			     uint16_t offset, uint8_t flags)
{
		struct ble_midi_parse_cb_t parse_cb = {
			.midi_message_cb = user_callbacks.midi_message_cb,
			.sysex_start_cb = user_callbacks.sysex_start_cb,
			.sysex_data_cb = user_callbacks.sysex_data_cb,
			.sysex_end_cb = user_callbacks.sysex_end_cb
		};
    // log_buffer("MIDI rx:", &((uint8_t *)buf)[offset], len);
    enum ble_midi_error_t rc = ble_midi_parse_packet(
        &((uint8_t *)buf)[offset],
        len,
        &parse_cb
    );
		if (rc != BLE_MIDI_SUCCESS) {
			LOG_ERR("ble_midi_parse_packet returned error %d", rc);
		}
}

static void midi_ccc_cfg_changed(const struct bt_gatt_attr *attr,
				  uint16_t value)
{
	/* MIDI I/O characteristic notification has been turned on.
			Notify the user that BLE MIDI is available. */
	if (user_callbacks.available_cb) {
		LOG_INF("BLE MIDI characteristic notification enabled");
		user_callbacks.available_cb(value == BT_GATT_CCC_NOTIFY);
	}
}

static const char *phy2str(uint8_t phy)
{
	switch (phy) {
	case 0: return "No packets";
	case BT_GAP_LE_PHY_1M: return "LE 1M";
	case BT_GAP_LE_PHY_2M: return "LE 2M";
	case BT_GAP_LE_PHY_CODED: return "LE Coded";
	default: return "Unknown";
	}
}

#define BT_UUID_MIDI_SERVICE BT_UUID_DECLARE_128(BLE_MIDI_SERVICE_UUID)
#define BT_UUID_MIDI_CHRC BT_UUID_DECLARE_128(BLE_MIDI_CHAR_UUID)

BT_GATT_SERVICE_DEFINE(ble_midi_service,
		       BT_GATT_PRIMARY_SERVICE(BT_UUID_MIDI_SERVICE),
		       BT_GATT_CHARACTERISTIC(BT_UUID_MIDI_CHRC,
					      BT_GATT_CHRC_READ | BT_GATT_CHRC_NOTIFY | BT_GATT_CHRC_WRITE_WITHOUT_RESP,
					      BT_GATT_PERM_READ | BT_GATT_PERM_WRITE,
					      midi_read_cb, midi_write_cb, NULL),
			BT_GATT_CCC(midi_ccc_cfg_changed, BT_GATT_PERM_READ | BT_GATT_PERM_WRITE),
		);

#define INTERVAL_MIN	0x6	/* 7.5 ms */
#define INTERVAL_MAX	0x6	/* 7.5 ms */
static struct bt_le_conn_param *conn_param =
	BT_LE_CONN_PARAM(INTERVAL_MIN, INTERVAL_MAX, 0, 200);
// static struct bt_conn_le_phy_param *phy_param = BT_CONN_LE_PHY_PARAM_2M;

/* static void mtu_exchange_func(struct bt_conn *conn, uint8_t att_err,
			  struct bt_gatt_exchange_params *params)
{
	struct bt_conn_info info = {0};
	int err;

	printk("MTU exchange %s\n", att_err == 0 ? "successful" : "failed");

	err = bt_conn_get_info(conn, &info);
	if (err) {
		printk("Failed to get connection info %d\n", err);
		return;
	}
} */

void mtu_updated(struct bt_conn *conn, uint16_t tx, uint16_t rx)
{
	/* From the BLE MIDI spec:
	 * "In transmitting MIDI data over Bluetooth, a series of MIDI messages of
	 * various sizes must be encoded into packets no larger than the negotiated
	 * MTU minus 3 bytes (typically 20 bytes or larger.)"
	 */
	int tx_buf_size_new = tx - 3;
	if (tx_writer.tx_buf_size > tx_buf_size_new) {
		LOG_WRN("Lowering tx_buf_size from %d to %d", tx_writer.tx_buf_size, tx_buf_size_new )
	}

	struct bt_conn_info info = {0};
	int e = bt_conn_get_info(conn, &info);

	int tx_buf_max_size = tx_buf_size > BLE_MIDI_TX_PACKET_MAX_SIZE ? BLE_MIDI_TX_PACKET_MAX_SIZE : tx_buf_size;
	tx_writer.tx_buf_max_size = tx_buf_max_size;
	sysex_tx_writer.tx_buf_max_size = tx_buf_max_size;
	LOG_INF("MTU changed to tx %d, rx %d, setting tx_buf_max_size to %d", tx, rx, tx_buf_max_size);
}

static struct bt_gatt_cb gatt_callbacks = {.att_mtu_updated = mtu_updated};

static void on_connected(struct bt_conn *conn, uint8_t err)
{
		int tx_running_status = CONFIG_BLE_MIDI_SEND_RUNNING_STATUS;
		int tx_note_off_as_note_on = CONFIG_BLE_MIDI_SEND_NOTE_OFF_AS_NOTE_ON;
		ble_midi_writer_init(&sysex_tx_writer, tx_running_status, tx_note_off_as_note_on);
		ble_midi_writer_init(&tx_writer, tx_running_status, tx_note_off_as_note_on);

		LOG_INF("Device connected, tx_running_status %d, tx_note_off_as_note_on %d", tx_running_status, tx_note_off_as_note_on);

		/* Request smallest possible connection interval, if not already set.
		   NOTE: The actual update request is sent after 5 seconds as required
			 by the Bluetooth Core specification spec. See BT_CONN_PARAM_UPDATE_TIMEOUT. */
		struct bt_conn_info info = {0};
		int e = bt_conn_get_info(conn, &info);
		if (info.le.interval > INTERVAL_MIN) {
			e = bt_conn_le_param_update(conn, conn_param);
			LOG_INF("Got conn. interval %d, requested interval %d with error %d",
							info.le.interval, INTERVAL_MIN, e);
		}

		irq_enable(TEMP_IRQn);
}

static void on_disconnected(struct bt_conn *conn, uint8_t reason)
{
		LOG_INF("Device disconnected");
    /* Device disconnected. Notify the user that BLE MIDI is not available. */
    if (user_callbacks.available_cb) {
      user_callbacks.available_cb(0);
    }
		irq_disable(TEMP_IRQn);

}

/*
static bool le_param_req(struct bt_conn *conn, struct bt_le_conn_param *param)
{
	LOG_INF("Connection parameters update request received.\n");
	printk("Minimum interval: %d, Maximum interval: %d\n",
	       param->interval_min, param->interval_max);
	printk("Latency: %d, Timeout: %d\n", param->latency, param->timeout);
	if (param->interval_max != INTERVAL_MAX) {
			int e = bt_conn_le_param_update(conn, conn_param);
			printk("bt_conn_le_param_update rc %d\n", e);
		}

	return true;
}*/

static void le_param_updated(struct bt_conn *conn, uint16_t interval,
			     uint16_t latency, uint16_t timeout)
{
	LOG_INF("Conn. params changed: interval: %d, latency: %d, timeout: %d",
	       interval, latency, timeout);
}

/*
static void le_phy_updated(struct bt_conn *conn,
			   struct bt_conn_le_phy_info *param)
{
	printk("LE PHY updated: TX PHY %s, RX PHY %s\n",
	       phy2str(param->tx_phy), phy2str(param->rx_phy));
} */

/*static void le_data_length_updated(struct bt_conn *conn,
				   struct bt_conn_le_data_len_info *info)
{
	printk("LE data len updated: TX (len: %d time: %d)"
	       " RX (len: %d time: %d)\n", info->tx_max_len,
	       info->tx_max_time, info->rx_max_len, info->rx_max_time);
}*/

uint16_t timestamp_ms() {
	return k_ticks_to_ms_near64(k_uptime_ticks()) & 0x1FFF;
}

#ifdef CONFIG_BLE_MIDI_NRF_BATCH_TX

#define RADIO_NOTIF_PRIORITY 1
static void radio_notif_work_cb(struct k_work * w)
{
	// printk("sending packet at %d\n", timestamp_ms());
	send_packet(tx_writer.tx_buf, tx_writer.tx_buf_size);
	ble_midi_writer_reset(&tx_writer);
	atomic_clear_bit(&has_tx_data, 0);
}

static void midi_msg_work_cb(struct k_work * w)
{
	uint8_t msg[3];
	ring_buf_get(&msg_ringbuf, msg, 3);
	uint16_t timestamp = timestamp_ms();
	ble_midi_writer_add_msg(&tx_writer, msg, timestamp);
	atomic_set_bit(&has_tx_data, 0);
}

K_WORK_DEFINE(radio_notif_work, radio_notif_work_cb);
K_WORK_DEFINE(midi_msg_work, midi_msg_work_cb);
static void radio_notif_handler(void)
{
	if (atomic_test_bit(&has_tx_data, 0)) {
		k_work_submit(&radio_notif_work);
	}
}

static void radio_notif_setup()
{
	int rc = mpsl_radio_notification_cfg_set(
		MPSL_RADIO_NOTIFICATION_TYPE_INT_ON_ACTIVE,
		MPSL_RADIO_NOTIFICATION_DISTANCE_420US, TEMP_IRQn);
	IRQ_CONNECT(TEMP_IRQn, RADIO_NOTIF_PRIORITY, radio_notif_handler, NULL,
		    0);
	__ASSERT(rc == 0, "mpsl_radio_notification_cfg_set failed");
}

SYS_INIT(radio_notif_setup, POST_KERNEL, 45);

#endif

BT_CONN_CB_DEFINE(ble_midi_conn_callbacks) = {
    .connected = on_connected,
    .disconnected = on_disconnected,
		// .le_param_req = le_param_req,
		.le_param_updated = le_param_updated,
		// .le_phy_updated = le_phy_updated
		// .le_data_len_updated = le_data_length_updated
};

void ble_midi_init(struct ble_midi_callbacks *callbacks) {
		bt_gatt_cb_register(&gatt_callbacks);
    user_callbacks.available_cb = callbacks->available_cb;
		user_callbacks.tx_available_cb = callbacks->tx_available_cb;
    user_callbacks.midi_message_cb = callbacks->midi_message_cb;
    user_callbacks.sysex_start_cb = callbacks->sysex_start_cb;
		user_callbacks.sysex_data_cb = callbacks->sysex_data_cb;
		user_callbacks.sysex_end_cb = callbacks->sysex_end_cb;
		LOG_INF("Initialized BLE MIDI");
}

static void on_notify_done(struct bt_conn *conn, void *user_data)
{
	/* BLE MIDI packet sent. */
	if (user_callbacks.tx_available_cb) {
		user_callbacks.tx_available_cb();
	}
}

int send_packet(uint8_t *bytes, int num_bytes)
{
	struct bt_gatt_notify_params notify_params = {
		.attr = &ble_midi_service.attrs[1],
		.data = bytes,
		.len = num_bytes,
		.func = on_notify_done,
	};
	int rc = bt_gatt_notify_cb(NULL, &notify_params);
	return rc == -ENOTCONN ? 0 : rc; // TODO: what does this do?
}

int ble_midi_tx_msg(uint8_t *bytes)
{
	#ifdef CONFIG_BLE_MIDI_NRF_BATCH_TX
	ring_buf_put(&msg_ringbuf, bytes, 3);
	k_work_submit(&midi_msg_work);
	#else
	ble_midi_writer_reset(&tx_writer);
	ble_midi_writer_add_msg(&tx_writer, bytes, timestamp_ms());
	return send_packet(tx_writer.tx_buf, tx_writer.tx_buf_size);
	#endif
}

int ble_midi_tx_sysex_start()
{
	ble_midi_writer_reset(&sysex_tx_writer);
	ble_midi_writer_start_sysex_msg(&sysex_tx_writer, timestamp_ms());
	return send_packet(sysex_tx_writer.tx_buf, sysex_tx_writer.tx_buf_size);
}

int ble_midi_tx_sysex_data(uint8_t* bytes, int num_bytes)
{
	int add_rc = ble_midi_writer_add_sysex_data(&sysex_tx_writer, bytes, num_bytes, timestamp_ms());
	if (add_rc < 0) { // TODO: how to interpret 0?
		LOG_ERR("ble_midi_writer_add_sysex_data failed with error %d", add_rc);
		return -EINVAL;
	}
	int send_rc = send_packet(sysex_tx_writer.tx_buf, sysex_tx_writer.tx_buf_size);
	if (send_rc == 0) {
		return add_rc; /* Return number of sent bytes on success */
	}
	return send_rc;
}

int ble_midi_tx_sysex_end()
{
	ble_midi_writer_end_sysex_msg(&sysex_tx_writer, timestamp_ms());
	return send_packet(sysex_tx_writer.tx_buf, sysex_tx_writer.tx_buf_size);
}
```

## src/ble_midi.h
```c
#ifndef _BLE_MIDI_H_
#define _BLE_MIDI_H_

#include <zephyr/zephyr.h>
#include <zephyr/bluetooth/uuid.h>
#include "ble_midi_packet.h"

#define BLE_MIDI_SERVICE_UUID \
	BT_UUID_128_ENCODE(0x03B80E5A, 0xEDE8, 0x4B33, 0xA751, 0x6CE34EC4C700)
#define BLE_MIDI_CHAR_UUID \
	BT_UUID_128_ENCODE(0x7772E5DB, 0x3868, 0x4112, 0xA1A9, 0xF2669D106BF3)

typedef void (*ble_midi_tx_available_cb_t)();
typedef void (*ble_midi_available_cb_t)(uint32_t is_available);

/** Callbacks set to NULL are ignored. */
struct ble_midi_callbacks {
  ble_midi_available_cb_t available_cb;
	ble_midi_tx_available_cb_t tx_available_cb;
	ble_midi_message_cb_t midi_message_cb;
	ble_midi_sysex_start_cb_t sysex_start_cb;
	ble_midi_sysex_data_cb_t sysex_data_cb;
	ble_midi_sysex_end_cb_t sysex_end_cb;
};

/**
 * Call once.
 */
void ble_midi_init(struct ble_midi_callbacks *callbacks);

/** Sends a non-sysex MIDI message. 3 zero padded bytes. */
int ble_midi_tx_msg(uint8_t* bytes);

int ble_midi_tx_sysex_start();
int ble_midi_tx_sysex_data(uint8_t* bytes, int num_bytes);
int ble_midi_tx_sysex_end();

#endif
```

## src/ble_midi_packet.c
```c
#include "ble_midi_packet.h"

static uint8_t timestamp_high(uint16_t timestamp_ms) {
	/* High 6 bits of 13 bit timestamp */
	return 0x3f & (timestamp_ms >> 7);
}

static uint8_t timestamp_low(uint16_t timestamp_ms) {
	/* Low 7 bits of 13 bit timestamp */
	return 0x7f & timestamp_ms;
}

static uint8_t header_byte(uint16_t timestamp_ms)
{
	return 0x80 | timestamp_high(timestamp_ms);
}

static uint8_t timestamp_byte(uint16_t timestamp_ms)
{
	return 0x80 | timestamp_low(timestamp_ms);
}

static uint16_t timestamp_ms(uint8_t timestamp_high, uint8_t timestamp_byte)
{
	return (timestamp_high << 7) | (0x7f & timestamp_byte);
}

static uint32_t is_status_byte(uint8_t byte)
{
	return byte >= 0x80;
}

static uint32_t is_data_byte(uint8_t byte)
{
	return byte < 0x80;
}

static uint32_t is_realtime_message(uint8_t status_byte)
{
	switch (status_byte) {
	case 0xf8: /* Timing Clock */
	case 0xfa: /* Start */
	case 0xfb: /* Continue */
	case 0xfc: /* Stop */
	case 0xfe: /* Active Sensing */
	case 0xff: /* System Reset */
		return 1;
	}

	return 0;
}

static uint32_t is_system_common_message(uint8_t status_byte)
{
	/* System common message? */
	switch (status_byte) {
	case 0xf1: /* MIDI Time Code Quarter Frame */
	case 0xf3: /* Song Select */
	case 0xf2: /* Song Position Pointer */
	case 0xf6: /* Tune request */
		return 1;
	}

	return 0;
}

static uint32_t is_channel_message(uint8_t status_byte)
{
	uint8_t high_nibble = status_byte >> 4;
	switch (high_nibble) {
	case 0x8: /* Note off */
	case 0x9: /* Note on */
	case 0xa: /* Poly KeyPress */
	case 0xb: /* Control Change */
	case 0xe: /* PitchBend Change */
	case 0xc: /* Program Change */
	case 0xd: /* Channel Pressure */
		return 1;
	}

	return 0;
}

static uint8_t message_size(uint8_t status_byte)
{
	/* Channel message? */
	uint8_t high_nibble = status_byte >> 4;
	switch (high_nibble) {
	case 0x8: /* Note off */
	case 0x9: /* Note on */
	case 0xa: /* Poly KeyPress */
	case 0xb: /* Control Change */
	case 0xe: /* PitchBend Change */
		/* Three byte channel Voice Message */
		return 3;
	case 0xc: /* Program Change */
	case 0xd: /* Channel Pressure */
		/* Two byte channel Voice Message */
		return 2;
	default:
		break;
	}

	/* Real time message? */
	switch (status_byte) {
	case 0xf8: /* Timing Clock */
	case 0xfa: /* Start */
	case 0xfb: /* Continue */
	case 0xfc: /* Stop */
	case 0xfe: /* Active Sensing */
	case 0xff: /* System Reset */
		return 1;
	default:
		break;
	}

	/* System common message? */
	switch (status_byte) {
	case 0xf1: /* MIDI Time Code Quarter Frame */
	case 0xf3: /* Song Select */
		/* 2 byte System Common message */
		return 2;
	case 0xf2: /* Song Position Pointer */
		/* 3 byte System Common message */
		return 3;
	case 0xf6: /* Tune request */
		   /* Single-byte System Common Message */
		return 1;
	}

	return 0;
}

void ble_midi_writer_init(struct ble_midi_writer_t *writer,
											    int running_status_enabled,
				  								int note_off_as_note_on)
{
	writer->tx_buf_max_size = BLE_MIDI_TX_PACKET_MAX_SIZE;
	writer->tx_buf_size = 0;
	writer->prev_running_status_byte = 0;
	writer->prev_status_byte = 0;
	writer->prev_timestamp = 0;
	writer->in_sysex_msg = 0;
	writer->note_off_as_note_on = note_off_as_note_on;
	writer->running_status_enabled = running_status_enabled;
}

void ble_midi_writer_reset(struct ble_midi_writer_t *writer)
{
	writer->tx_buf_size = 0;
	writer->prev_timestamp = 0;

	/* The end of a BLE packet cancels running status. */
	writer->prev_running_status_byte = 0;
	writer->prev_status_byte = 0;
}

enum ble_midi_error_t ble_midi_writer_add_msg(struct ble_midi_writer_t *writer,
														uint8_t *message_bytes, uint16_t timestamp)
{
	/* First, handle special case of system real time message in a sysex message */
	if (writer->in_sysex_msg) {
		if (is_realtime_message(message_bytes[0])) {
			if (writer->tx_buf_max_size - writer->tx_buf_size >= 2)
			{
				writer->tx_buf[writer->tx_buf_size] = timestamp_byte(timestamp);
				writer->tx_buf_size++;
				writer->tx_buf[writer->tx_buf_size] = message_bytes[0];
				writer->tx_buf_size++;
				return BLE_MIDI_SUCCESS;
			}
			else {
				return BLE_MIDI_ERROR_PACKET_FULL;
			}
		}
		else {
			/* Only real time messages allowed in sysex data */
			return BLE_MIDI_ERROR_INVALID_STATUS_BYTE;
		}
	}

	/* The following code appends a MIDI message to the BLE MIDI packet in two steps:
	   1. Compute a maximum of 5 bytes to append
	     - packet header?
	     - message timestamp?
	     - 1-3 midi bytes
	   2. Append the bytes if there is room in the packet.
	*/
	uint8_t status_byte = message_bytes[0];
	uint8_t num_message_bytes = message_size(status_byte);
	if (num_message_bytes == 0) {
		return BLE_MIDI_ERROR_INVALID_STATUS_BYTE;
	}

	uint8_t data_bytes[2] = {message_bytes[1], message_bytes[2]};
	for (int i = 0; i < num_message_bytes - 1; i++) {
		if (!is_data_byte(data_bytes[i])) {
			return BLE_MIDI_ERROR_INVALID_DATA_BYTE;
		}
	}

	/* Use running status? */
	uint8_t prev_running_status_byte = writer->prev_running_status_byte;

	if (!writer->running_status_enabled) {
		prev_running_status_byte = 0;
	}
	else if (is_channel_message(status_byte)) {
		if ((status_byte >> 4) == 0x8 && writer->note_off_as_note_on) {
			/* This is a note off message. Represent it as a note
			    on with velocity 0 to increase running status efficiency. */
			status_byte = 0x90 | (status_byte & 0xf);
			data_bytes[1] = 0; /* Velocity 0 */
		}

		prev_running_status_byte = status_byte;
	}
	else if (is_realtime_message(status_byte) || is_system_common_message(status_byte)) {
		/*
		   From the BLE MIDI spec:
		   System Common and System Real-Time messages do not cancel Running Status if
		   interspersed between Running Status MIDI messages. However, a timestamp byte
		   must precede the Running Status MIDI message that follows.
		*/
	}
	else {
		/* Cancel running status */
		prev_running_status_byte = 0;
	}

	uint8_t bytes_to_append[5] = {0, 0, 0, 0, 0 };
	uint8_t num_bytes_to_append = 0;

	/* Add packet header byte? */
	if (writer->tx_buf_size == 0) {
		bytes_to_append[num_bytes_to_append] = header_byte(timestamp);
		num_bytes_to_append++;
	}

	/* Skip the message timestamp if we're in a running status sequence, the timestamp
	   hasn't changed and we're dealing with a channel message that was not preceded
	   by a system realtime/common message. */
	int is_running_status = status_byte == writer->prev_running_status_byte;
	uint16_t prev_timestamp = writer->prev_timestamp;
	int prev_msg_is_sys_rt_or_cmn = is_system_common_message(writer->prev_status_byte) || is_realtime_message(writer->prev_status_byte);
	int skip_msg_timestamp = is_running_status && timestamp == prev_timestamp && is_channel_message(status_byte) && !prev_msg_is_sys_rt_or_cmn;
	if (!skip_msg_timestamp) {
		bytes_to_append[num_bytes_to_append] = timestamp_byte(timestamp);
		num_bytes_to_append++;
	}

	/* Skip the status byte if we're in a running status sequence and this is a channel message */
	int skip_status_byte = is_running_status && is_channel_message(status_byte);
	if (!skip_status_byte) {
		bytes_to_append[num_bytes_to_append] = status_byte;
		num_bytes_to_append++;
	}

	/* Add data bytes */
	uint8_t num_data_bytes = num_message_bytes - 1;
	for (int i = 0; i < num_data_bytes; i++) {
		bytes_to_append[num_bytes_to_append] = data_bytes[i];
		num_bytes_to_append++;
	}

	/* Append bytes to the BLE packet */
	if (writer->tx_buf_size + num_bytes_to_append <= writer->tx_buf_max_size) {
		for (int i = 0; i < num_bytes_to_append; i++) {
			writer->tx_buf[writer->tx_buf_size] = bytes_to_append[i];
			writer->tx_buf_size++;
		}

		/* Update packet state */
		writer->prev_status_byte = status_byte;
		writer->prev_running_status_byte = prev_running_status_byte;
		writer->prev_timestamp = timestamp;

		return BLE_MIDI_SUCCESS;
	}
	else {
		return BLE_MIDI_ERROR_PACKET_FULL;
	}
}

enum ble_midi_error_t ble_midi_writer_add_sysex_msg(
    struct ble_midi_writer_t *writer,
    uint8_t *bytes,
    uint32_t num_bytes,
    uint16_t timestamp
)
{
	/* Validate sysex message */
	if (num_bytes < 2) {
		return BLE_MIDI_ERROR_INVALID_MESSAGE;
	}
	for (int i = 0; i < num_bytes; i++) {
		if (i == 0) {
			if (bytes[i] != 0xf0) {
				return BLE_MIDI_ERROR_INVALID_STATUS_BYTE;
			}
		}
		else if (i == num_bytes - 1) {
			if (bytes[i] != 0xf7) {
				return BLE_MIDI_ERROR_INVALID_STATUS_BYTE;
			}
		}
		else if (!is_data_byte(bytes[i])) {
			return BLE_MIDI_ERROR_INVALID_DATA_BYTE;
		}
	}

	/* See if there's room in the packet */
	int num_bytes_to_append = num_bytes + 2; /* +2 for timestamp bytes */
	if (writer->tx_buf_size == 0) {
		num_bytes_to_append++;
	}
	if (writer->tx_buf_max_size - writer->tx_buf_size < num_bytes_to_append) {
		return BLE_MIDI_ERROR_PACKET_FULL;
	}

	/* Add packet header? */
	if (writer->tx_buf_size == 0) {
		writer->tx_buf[writer->tx_buf_size] = header_byte(timestamp);
		writer->tx_buf_size++;
	}

	/* Add message bytes */
	for (int i = 0; i < num_bytes; i++) {
		if (i == 0 || i == num_bytes - 1) {
			writer->tx_buf[writer->tx_buf_size] = timestamp_byte(timestamp);
			writer->tx_buf_size++;
		}
		writer->tx_buf[writer->tx_buf_size] = bytes[i];
		writer->tx_buf_size++;
	}

	/* Cancel running status */
	writer->prev_running_status_byte = 0;

	return BLE_MIDI_SUCCESS;
}

enum ble_midi_error_t append_status_byte_with_timestamp(struct ble_midi_writer_t *writer, uint16_t timestamp, uint8_t status)
{
	int num_bytes_to_append = 2;
	if (writer->tx_buf_size == 0) {
		/* Also add packet header */
		num_bytes_to_append++;
	}
	if (writer->tx_buf_max_size - writer->tx_buf_size < num_bytes_to_append) {
		return BLE_MIDI_ERROR_PACKET_FULL;
	}

	/* If we made it here, there's room in the packet for the sysex start message. */
	if (writer->tx_buf_size == 0) {
		writer->tx_buf[writer->tx_buf_size] = header_byte(timestamp);
		writer->tx_buf_size++;
	}

	writer->tx_buf[writer->tx_buf_size] = timestamp_byte(timestamp);
	writer->tx_buf_size++;
	writer->tx_buf[writer->tx_buf_size] = status;
	writer->tx_buf_size++;

	return BLE_MIDI_SUCCESS;
}

enum ble_midi_error_t ble_midi_writer_start_sysex_msg(struct ble_midi_writer_t *writer, uint16_t timestamp)
{
	if (writer->in_sysex_msg) {
		return BLE_MIDI_ERROR_IN_SYSEX_SEQUENCE;
	}
	enum ble_midi_error_t result = append_status_byte_with_timestamp(writer, timestamp, 0xf0);
	if (result == BLE_MIDI_SUCCESS) {
		writer->in_sysex_msg = 1;
		writer->prev_running_status_byte = 0;
	}
	return result;
}

enum ble_midi_error_t ble_midi_writer_end_sysex_msg(struct ble_midi_writer_t *writer, uint16_t timestamp)
{
	if (!writer->in_sysex_msg) {
		return BLE_MIDI_ERROR_NOT_IN_SYSEX_SEQUENCE;
	}
	enum ble_midi_error_t result = append_status_byte_with_timestamp(writer, timestamp, 0xf7);
	if (result == BLE_MIDI_SUCCESS) {
		writer->in_sysex_msg = 0;
	}
	return result;
}

int ble_midi_writer_add_sysex_data(struct ble_midi_writer_t *writer, uint8_t *data_bytes, uint32_t num_data_bytes, uint16_t timestamp)
{
	if (!writer->in_sysex_msg) {
		return BLE_MIDI_ERROR_NOT_IN_SYSEX_SEQUENCE;
	}

	/* Validate data bytes */
	for (int i = 0; i < num_data_bytes; i++)
	{
		if (!is_data_byte(data_bytes[i])) {
			return BLE_MIDI_ERROR_INVALID_DATA_BYTE;
		}
	}

	/* Add packet header */
	if (writer->tx_buf_size == 0) {
		if (writer->tx_buf_max_size < 1) {
			return BLE_MIDI_ERROR_PACKET_FULL;
		}
		writer->tx_buf[writer->tx_buf_size] = header_byte(timestamp);
		writer->tx_buf_size++;
	}

	/* Add data bytes until end of data or end of packet. */
	int num_bytes_left = writer->tx_buf_max_size - writer->tx_buf_size;
	int num_data_bytes_to_add = num_bytes_left < num_data_bytes ? num_bytes_left : num_data_bytes;
	for (int i = 0; i < num_data_bytes_to_add; i++) {
		writer->tx_buf[writer->tx_buf_size] = data_bytes[i];
		writer->tx_buf_size++;
	}

	/* Return the number of data bytes added */
	return num_data_bytes_to_add;
}

struct ble_midi_parser_t {
	uint8_t in_sysex_msg;
	uint8_t running_status_byte;
	uint8_t prev_timestamp_byte;
	uint32_t read_pos;
	uint8_t *rx_buf;
	uint32_t rx_buf_size;
};

static enum ble_midi_error_t ble_midi_parser_read(struct ble_midi_parser_t *parser, uint8_t* result, uint32_t num_bytes) {
	if (parser->read_pos <= parser->rx_buf_size - num_bytes) {
		for (int i = 0; i < num_bytes; i++) {
			result[i] = parser->rx_buf[parser->read_pos];
			parser->read_pos++;
		}
		return BLE_MIDI_SUCCESS;
	} else {
		return BLE_MIDI_ERROR_UNEXPECTED_END_OF_DATA;
	}
}

static enum ble_midi_error_t is_sysex_continuation(struct ble_midi_parser_t *parser, int *is_sysex)
{
	*is_sysex = 0;

	/* A sysex continuation packet starts with
	  - a packet header
		- 0 or more system realtime messages with timestamps
		- a data byte */
	uint8_t header = 0;
	if (ble_midi_parser_read(parser, &header, 1)) {
		return BLE_MIDI_ERROR_UNEXPECTED_END_OF_DATA;
	}

	while (parser->read_pos < parser->rx_buf_size) {
		uint8_t byte_1 = 0;
		if (ble_midi_parser_read(parser, &byte_1, 1)) {
			return BLE_MIDI_ERROR_UNEXPECTED_END_OF_DATA;
		}
		if (is_data_byte(byte_1)) {
			*is_sysex = 1;
			return BLE_MIDI_SUCCESS;
		}
		uint8_t byte_2 = 0;
		if (ble_midi_parser_read(parser, &byte_2, 1)) {
			return BLE_MIDI_ERROR_UNEXPECTED_END_OF_DATA;
		}

		if (is_data_byte(byte_2)) {
			return BLE_MIDI_ERROR_UNEXPECTED_DATA_BYTE;
		}
		if (is_realtime_message(byte_2)) {
			/* A system real time message. Keep going.  */
		} else {
			/* A status byte other than system real time.
			Not a sysex continuation packet */
			return BLE_MIDI_SUCCESS;
		}
	}

	return BLE_MIDI_SUCCESS;
}

enum ble_midi_error_t ble_midi_parse_packet(
    uint8_t *rx_buf,
    uint32_t rx_buf_size,
    struct ble_midi_parse_cb_t *cb
)
{
	/* A parser instance keeping track of the parsing state. */
	struct ble_midi_parser_t parser = {
		.in_sysex_msg = 0,
		.prev_timestamp_byte = 0,
		.rx_buf = rx_buf,
		.rx_buf_size = rx_buf_size,
		.read_pos = 0,
		.running_status_byte = 0
	};

	/* First, check if this is a sysex continuation packet. */
	int is_sysex_cont = 0;
	int res = is_sysex_continuation(&parser, &is_sysex_cont);
	if (res != BLE_MIDI_SUCCESS) {
		return res;
	}
	parser.in_sysex_msg = is_sysex_cont;

	/* Reset read position and do the actual parsing */
	parser.read_pos = 0;

	/* Start actual parsing by reading packet header */
	uint8_t packet_header = 0;
	if (ble_midi_parser_read(&parser, &packet_header, 1)) {
		return BLE_MIDI_ERROR_UNEXPECTED_END_OF_DATA;
	}
	uint8_t timestamp_high_bits = 0x3f & packet_header;

	if (!is_status_byte(packet_header)) {
		return BLE_MIDI_ERROR_INVALID_HEADER_BYTE;
	}

	/* Parse messages */
	while (parser.read_pos < parser.rx_buf_size) {
		if (parser.in_sysex_msg) {
			/* Only data bytes or system real time with timestamp allowed in sysex messages */
			uint8_t byte = 0;
			if (ble_midi_parser_read(&parser, &byte, 1)) {
				return BLE_MIDI_ERROR_UNEXPECTED_END_OF_DATA;
			}

			if (is_data_byte(byte)) {
				if (cb->sysex_data_cb) {
					cb->sysex_data_cb(byte);
				}
			} else {
				/* Assume we just read a timestamp byte. It may be followed by a
				  system real time status or sysex end */
				uint8_t status = 0;
				if (ble_midi_parser_read(&parser, &status, 1)) {
					return BLE_MIDI_ERROR_UNEXPECTED_END_OF_DATA;
				}
				if (is_realtime_message(status)) {
					if (cb->midi_message_cb) {
						cb->midi_message_cb(&status, 1, timestamp_ms(timestamp_high_bits, byte));
					}
				} else if (status == 0xf7) {
					/* End of sysex */
					parser.in_sysex_msg = 0;
					if (cb->sysex_end_cb) {
						cb->sysex_end_cb(timestamp_ms(timestamp_high_bits, byte));
					}
				} else {
					/* Invalid status byte. Ignore. */
				}
			}
		}
		else {
			/*
			Expecting one of these cases:
			Case 1. data byte(s) (running status without timestamp)
			Case 2. timestamp byte + data byte(s) (running status with timestamp)
			Case 3. timestamp byte + status byte + zero or more data bytes (complete MIDI message with timestamp)
			*/
			uint8_t byte_0 = 0;
			if (ble_midi_parser_read(&parser, &byte_0, 1)) {
				return BLE_MIDI_ERROR_UNEXPECTED_END_OF_DATA;
			}
			if (is_data_byte(byte_0)) {
				/* Case 1 - running status without timestamp byte.
				Read the rest of the data bytes. */
				uint8_t status_byte = parser.running_status_byte;
				uint8_t message_bytes[3] = {status_byte, byte_0, 0};
				uint8_t num_message_bytes = message_size(status_byte);
				uint8_t num_additional_data_bytes = num_message_bytes - 2;
				if (ble_midi_parser_read(&parser, &message_bytes[2], num_additional_data_bytes)) {
					return BLE_MIDI_ERROR_UNEXPECTED_END_OF_DATA;
				}
				if (cb->midi_message_cb) {
					cb->midi_message_cb(message_bytes, num_message_bytes, timestamp_ms(timestamp_high_bits, parser.prev_timestamp_byte));
				}
			} else {
				/* Assume byte_0 is a timestamp byte. At least one byte should follow. */
				uint8_t byte_1 = 0;
				if (parser.prev_timestamp_byte > byte_0) {
					timestamp_high_bits = (timestamp_high_bits + 1) % 0x40;
				}
				parser.prev_timestamp_byte = byte_0;
				if (ble_midi_parser_read(&parser, &byte_1, 1)) {
					return BLE_MIDI_ERROR_UNEXPECTED_END_OF_DATA;
				}

				if (is_data_byte(byte_1)) {
					/* Case 2 - running status with timestamp */
					uint8_t status_byte = parser.running_status_byte;
					uint8_t message_bytes[3] = {status_byte, byte_1, 0};
					uint8_t num_message_bytes = message_size(status_byte);
					uint8_t num_additional_data_bytes = num_message_bytes - 2;
					if (ble_midi_parser_read(&parser, &message_bytes[2], num_additional_data_bytes)) {
						return BLE_MIDI_ERROR_UNEXPECTED_END_OF_DATA;
					}
					if (cb->midi_message_cb) {
						cb->midi_message_cb(message_bytes, num_message_bytes, timestamp_ms(timestamp_high_bits, byte_0));
					}
				} else {
					/* Case 3 */
					/* byte_1 is the status byte of this message. update running status */

					if (is_channel_message(byte_1)) {
						parser.running_status_byte = byte_1;
					} else if (!is_realtime_message(byte_1) && !is_system_common_message(byte_1)) {
						parser.running_status_byte = 0;
					}

					if (byte_1 == 0xf0) {
						/* Sysex start */
						parser.in_sysex_msg = 1;
						if (cb->sysex_start_cb) {
							cb->sysex_start_cb(timestamp_ms(timestamp_high_bits, byte_0));
						}
					}
					else {
						uint8_t num_data_bytes = message_size(byte_1) - 1;
						if (num_data_bytes >= 0) {
							uint8_t message_bytes[3] = {byte_1, 0, 0};
							if (ble_midi_parser_read(&parser, &message_bytes[1], num_data_bytes)) {
								return BLE_MIDI_ERROR_UNEXPECTED_END_OF_DATA;
							}
							if (cb->midi_message_cb) {
								cb->midi_message_cb(message_bytes, 1 + num_data_bytes, timestamp_ms(timestamp_high_bits, byte_0));
							}
						} else {
							return BLE_MIDI_ERROR_INVALID_STATUS_BYTE;
						}
					}
				}
			}
		}
	}

	return BLE_MIDI_SUCCESS;
}
```

## src/ble_midi_packet.h
```c
#ifndef _BLE_MIDI_PACKET_H_
#define _BLE_MIDI_PACKET_H_

#include <stdint.h>

enum ble_midi_error_t {
	BLE_MIDI_SUCCESS = 0,
	BLE_MIDI_ERROR_PACKET_FULL = -1,
	BLE_MIDI_ERROR_IN_SYSEX_SEQUENCE = -2,
	BLE_MIDI_ERROR_NOT_IN_SYSEX_SEQUENCE = -3,
	BLE_MIDI_ERROR_INVALID_DATA_BYTE = -4,
	BLE_MIDI_ERROR_INVALID_STATUS_BYTE = -5,
	BLE_MIDI_ERROR_INVALID_MESSAGE = -6,
	BLE_MIDI_ERROR_UNEXPECTED_END_OF_DATA = -7,
	BLE_MIDI_ERROR_UNEXPECTED_DATA_BYTE = -8,
	BLE_MIDI_ERROR_UNEXPECTED_STATUS_BYTE = -9,
	BLE_MIDI_ERROR_INVALID_HEADER_BYTE = -10
};

/** Called when a non-sysex message has been parsed */
typedef void (*ble_midi_message_cb_t)(uint8_t *bytes, uint8_t num_bytes, uint16_t timestamp);
/** Called when a sysex message starts */
typedef void (*ble_midi_sysex_start_cb_t)(uint16_t timestamp);
/** Called when a sysex data byte has been received */
typedef void (*ble_midi_sysex_data_cb_t)(uint8_t data_byte);
/** Called when a sysex message ends */
typedef void (*ble_midi_sysex_end_cb_t)(uint16_t timestamp);

/**
 * BLE MIDI packet parsing callbacks.
 * A callback that is set to NULL is ignored.
 */
struct ble_midi_parse_cb_t {
	ble_midi_message_cb_t midi_message_cb;
  ble_midi_sysex_data_cb_t sysex_data_cb;
	ble_midi_sysex_start_cb_t sysex_start_cb;
	ble_midi_sysex_end_cb_t sysex_end_cb;
};

/**
 * Parses an entire BLE MIDI packet.
 */
enum ble_midi_error_t ble_midi_parse_packet(
    uint8_t *rx_buf,
    uint32_t rx_buf_size,
    struct ble_midi_parse_cb_t *cb
);

#define BLE_MIDI_TX_PACKET_MAX_SIZE 64

/**
 * Keeps track of the state when writing BLE MIDI packets.
 */
struct ble_midi_writer_t
{
	/* The packet to send. */
	uint8_t tx_buf[BLE_MIDI_TX_PACKET_MAX_SIZE];
	/* Current maximum packet size. Must not be greater than BLE_MIDI_TX_PACKET_MAX_SIZE */
	uint16_t tx_buf_max_size;
	/* Current packet size. Must not be greater than max_size. */
	uint16_t tx_buf_size;
	/* Status byte of the previous message */
	uint8_t prev_status_byte;
	/* Status byte of the previous non-realtime/common message. Used for running status. */
	uint8_t prev_running_status_byte;
	/* The timestamp of the previously added message. Used to determine if timestamp bytes
	   should be added to running status messages. */
	uint16_t prev_timestamp;
	/* Non-zero if sysex writing is in progress */
	uint8_t in_sysex_msg;
	/* Indicates if running status should be used. */
	int running_status_enabled;
	/* Indicates if note off messages should be represented as zero velocity note on messages. */
	int note_off_as_note_on;
};

/* Called once before using the writer. */
void ble_midi_writer_init(struct ble_midi_writer_t *writer,
		  										int running_status_enabled,
				  								int note_off_as_note_on);

/* Called after finishing writing a packet. */
void ble_midi_writer_reset(struct ble_midi_writer_t *writer);

/* Append a non-sysex MIDI message. */
enum ble_midi_error_t ble_midi_writer_add_msg(
    struct ble_midi_writer_t *writer,
    uint8_t *bytes,	/* 3 bytes, zero padded */
    uint16_t timestamp /* 13 bit, wrapped ms timestamp */
);

/* Append an entire sysex MIDI message. Fails if the message does not fit into the packet. */
enum ble_midi_error_t ble_midi_writer_add_sysex_msg(
    struct ble_midi_writer_t *writer,
    uint8_t *bytes,
    uint32_t num_bytes,
    uint16_t timestamp);

/* Start a sysex message, possibly spanning multiple messages. */
enum ble_midi_error_t ble_midi_writer_start_sysex_msg(struct ble_midi_writer_t *writer, uint16_t timestamp);

/**
 * Append data bytes to an ongoing sysex message, possibly spanning multiple packets.
 * The chunk must not contain sysex start/end and system real time status bytes.
 * Returns a non-negative value on success, indicating the number of bytes written to the packet.
 * Negative return values correspond to error codes from the ble_midi_error_t enum.
 */
int ble_midi_writer_add_sysex_data(
    struct ble_midi_writer_t *writer,
    uint8_t *data_bytes,
    uint32_t num_data_bytes,
    uint16_t timestamp);

/* End a sysex message, possibly spanning multiple messages. */
enum ble_midi_error_t ble_midi_writer_end_sysex_msg(struct ble_midi_writer_t *writer, uint16_t timestamp);

#endif
```

## src/ble_pairing.h
```c
#ifndef __BLE_BONDING_H__
#define __BLE_BONDING_H__

#include <zephyr/bluetooth/bluetooth.h>

// called before bt_enable
int ble_pairing_init();

// called after bt_enable
int ble_pairing_load();

int ble_pairing_clear();

void advertise_with_accept_list(const struct bt_data *ad, int ad_size, const struct bt_data *sd, int sd_size);

int ble_disconnect_if_connected();

#endif 
```
